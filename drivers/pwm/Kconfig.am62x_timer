## drivers/pwm/Kconfig.am62x_timer
```kconfig
# Copyright 2025 
# SPDX-License-Identifier: Apache-2.0

config PWM_AM62X_TIMER
    bool "AM62x Timer PWM support"
    default y
    depends on DT_HAS_TI_AM62X_TIMER_PWM_ENABLED
    select PINCTRL
    help
      Enable PWM support using the Timer on TI AM62x processors.
```

## dts/bindings/pwm/ti,am62x-timer-pwm.yaml
```yaml
# Copyright 2025
# SPDX-License-Identifier: Apache-2.0

description: TI AM62x Timer PWM Controller

compatible: "ti,am62x-timer-pwm"

include: [pwm-controller.yaml, base.yaml, pinctrl-device.yaml]

properties:
  pinctrl-0:
    required: true
  reg:
    description: Memory address of the timer
    required: true
  clock-frequency:
    type: int
    description: Reference to the clock frequency
    required: true
  clock-prescaler:
    type: int
    description: Reference to the clock prescaler
    required: true

  "#pwm-cells":
    const: 3

pwm-cells:
  - channel
  - period
  - flags
```
